/**
 * @cliArgs --device "AM62x" --package "ALW" --part "Default" --context "r5fss0-0" --product "MCU_PLUS_SDK@07.03.01"
 * @versions {"tool":"1.14.0+2667"}
 */

/**
 * Import the modules used in this configuration.
 */
const bootloader  = scripting.addModule("/drivers/bootloader/bootloader", {}, false);
const bootloader1 = bootloader.addInstance();
const gpio        = scripting.addModule("/drivers/gpio/gpio", {}, false);
const gpio1       = gpio.addInstance();
const uart        = scripting.addModule("/drivers/uart/uart", {}, false);
const uart1       = uart.addInstance();
const clock       = scripting.addModule("/kernel/dpl/clock");
const debug_log   = scripting.addModule("/kernel/dpl/debug_log");

/**
 * Write custom configuration values to the imported modules.
 */
bootloader1.$name     = "CONFIG_BOOTLOADER0";
bootloader1.bootMedia = "MEM";

gpio1.$name                = "GPIO_VPP";
gpio1.pinDir               = "OUTPUT";
gpio1.GPIO.gpioPin.$assign = "VOUT0_DATA2";

uart1.$name                      = "CONFIG_UART1";
uart1.useWakeupDomainPeripherals = false;
uart1.UART.$assign               = "USART1";

clock.instance = "TIMER1";

debug_log.enableUartLog                      = true;
debug_log.enableLogZoneInfo                  = true;
debug_log.enableCssLog                       = false;
debug_log.uartLog.$name                      = "CONFIG_UART0";
debug_log.uartLog.useWakeupDomainPeripherals = false;
debug_log.uartLog.UART.$assign               = "USART0";

/**
 * Pinmux solution for unlocked pins/peripherals. This ensures that minor changes to the automatic solver in a future
 * version of the tool will not impact the pinmux you originally saw.  These lines can be completely deleted in order to
 * re-solve from scratch.
 */
gpio1.GPIO.$suggestSolution                 = "GPIO0"
uart1.UART.RXD.$suggestSolution             = "ball.E19";
uart1.UART.TXD.$suggestSolution             = "ball.A20";
debug_log.uartLog.UART.RXD.$suggestSolution = "ball.D14";
debug_log.uartLog.UART.TXD.$suggestSolution = "ball.E14";
